## board/reflexces/achilles-v2-indus/Kconfig
```kconfig
if TARGET_SOCFPGA_ARRIA10_ACHILLES_V2_INDUS

config SYS_CPU
	default "armv7"

config SYS_BOARD
	default "achilles-v2-indus"

config SYS_VENDOR
	default "reflexces"

config SYS_SOC
	default "socfpga_arria10"

config SYS_CONFIG_NAME
	default "socfpga_arria10_achilles_v2_indus"

endif
```

## board/reflexces/achilles-v2-indus/fit_spl_fpga.its
```
// SPDX-License-Identifier: GPL-2.0
/*
 * Copyright (C) 2022 REFLEX CES <www.reflexces.com>
 *
 */

/dts-v1/;

/ {
	description = "FIT image with FPGA core bistream";
	#address-cells = <1>;

	images {
		fpga-core-1 {
			description = "FPGA core bitstream";
			data = /incbin/("../../../achilles_v2_indus_ghrd.core.rbf");
			type = "fpga";
			arch = "arm";
			compression = "none";
		};
	};

	configurations {
		default = "config-1";
		config-1 {
			description = "Configure FPGA core image";
			fpga = "fpga-core-1";
		};
	};
};
```

## board/reflexces/achilles-v2-indus/fit_spl_fpga_periph_only.its
```
// SPDX-License-Identifier: GPL-2.0
/*
 * Copyright (C) 2022 REFLEX CES <www.reflexces.com>
 *
 */

/dts-v1/;

/ {
	description = "FIT image with FPGA peripheral bistream";
	#address-cells = <1>;

	images {
		fpga-periph-1 {
			description = "FPGA peripheral bitstream";
			data = /incbin/("../../../achilles_v2_indus_ghrd.periph.rbf");
			type = "fpga";
			arch = "arm";
			compression = "none";
		};
	};

	configurations {
		default = "config-1";
		config-1 {
			description = "Boot with FPGA early IO release config";
			fpga = "fpga-periph-1";
		};
	};
};
```

## board/reflexces/achilles-v2-lite/fit_kernel.its
```
// SPDX-License-Identifier: GPL-2.0
/*
 * Copyright (C) 2022 REFLEX CES <www.reflexces.com>
 *
 */

/dts-v1/;

/ {
	description = "FIT image with kernel and DTB";
	#address-cells = <1>;

	images {
		kernel {
			description = "Linux Kernel";
			data = /incbin/("../../../zImage");
			type = "kernel";
			os = "linux";
			arch = "arm";
			compression = "none";
			load = <0x8000>;
			entry = <0x8000>;
		};

		fdt {
			description = "Linux DTB";
			data = /incbin/("../../../socfpga_arria10_achilles_v2_lite.dtb");
			type = "flat_dt";
			os = "linux";
			arch = "arm";
			compression = "none";

		};
	};

	configurations {
		default = "conf";
		conf {
			description = "Linux boot configuration";
			kernel = "kernel";
			fdt = "fdt";
		};
	};
};
```

## board/reflexces/achilles-v2-turbo/Kconfig
```kconfig
if TARGET_SOCFPGA_ARRIA10_ACHILLES_V2_TURBO

config SYS_CPU
	default "armv7"

config SYS_BOARD
	default "achilles-v2-turbo"

config SYS_VENDOR
	default "reflexces"

config SYS_SOC
	default "socfpga_arria10"

config SYS_CONFIG_NAME
	default "socfpga_arria10_achilles_v2_turbo"

endif
```
